## twister-out/native_sim_native/host_gnu/zephyr-intermediate/tests/temp_alarm/homework.unit.temp_alarm/Kconfig/soc/Kconfig.tmp
```kconfig
# Load Zephyr SoC Kconfig descriptions.
osource "/home/adam/iomico/zephyr/soc/xlnx/zynqmp/Kconfig"
osource "/home/adam/iomico/zephyr/soc/xlnx/zynq7000/Kconfig"
osource "/home/adam/iomico/zephyr/soc/xlnx/versalnet/Kconfig"
osource "/home/adam/iomico/zephyr/soc/xlnx/versal2/Kconfig"
osource "/home/adam/iomico/zephyr/soc/xlnx/versal/Kconfig"
osource "/home/adam/iomico/zephyr/soc/xen/Kconfig"
osource "/home/adam/iomico/zephyr/soc/wch/ch32v/Kconfig"
osource "/home/adam/iomico/zephyr/soc/ti/simplelink/Kconfig"
osource "/home/adam/iomico/zephyr/soc/ti/mspm0/Kconfig"
osource "/home/adam/iomico/zephyr/soc/ti/lm3s6965/Kconfig"
osource "/home/adam/iomico/zephyr/soc/ti/k3/Kconfig"
osource "/home/adam/iomico/zephyr/soc/telink/tlsr/Kconfig"
osource "/home/adam/iomico/zephyr/soc/syna/sr100/Kconfig"
osource "/home/adam/iomico/zephyr/soc/starfive/jh71xx/Kconfig"
osource "/home/adam/iomico/zephyr/soc/st/stm32/Kconfig"
osource "/home/adam/iomico/zephyr/soc/snps/qemu_arc/Kconfig"
osource "/home/adam/iomico/zephyr/soc/snps/nsim/arc_v/Kconfig"
osource "/home/adam/iomico/zephyr/soc/snps/nsim/arc_classic/Kconfig"
osource "/home/adam/iomico/zephyr/soc/snps/hsdk4xd/Kconfig"
osource "/home/adam/iomico/zephyr/soc/snps/hsdk/Kconfig"
osource "/home/adam/iomico/zephyr/soc/snps/emsk/Kconfig"
osource "/home/adam/iomico/zephyr/soc/snps/emsdp/Kconfig"
osource "/home/adam/iomico/zephyr/soc/snps/arc_iot/Kconfig"
osource "/home/adam/iomico/zephyr/soc/silabs/Kconfig"
osource "/home/adam/iomico/zephyr/soc/sifli/sf32/Kconfig"
osource "/home/adam/iomico/zephyr/soc/sifive/sifive_freedom/Kconfig"
osource "/home/adam/iomico/zephyr/soc/sensry/Kconfig"
osource "/home/adam/iomico/zephyr/soc/rockchip/Kconfig"
osource "/home/adam/iomico/zephyr/soc/renode/riscv_virtual/Kconfig"
osource "/home/adam/iomico/zephyr/soc/renode/cortex_r8_virtual/Kconfig"
osource "/home/adam/iomico/zephyr/soc/renesas/smartbond/Kconfig"
osource "/home/adam/iomico/zephyr/soc/renesas/rz/Kconfig"
osource "/home/adam/iomico/zephyr/soc/renesas/rx/Kconfig"
osource "/home/adam/iomico/zephyr/soc/renesas/rcar/Kconfig"
osource "/home/adam/iomico/zephyr/soc/renesas/ra/Kconfig"
osource "/home/adam/iomico/zephyr/soc/realtek/fingerprint/Kconfig"
osource "/home/adam/iomico/zephyr/soc/realtek/ec/Kconfig"
osource "/home/adam/iomico/zephyr/soc/realtek/bee/Kconfig"
osource "/home/adam/iomico/zephyr/soc/realtek/ameba/Kconfig"
osource "/home/adam/iomico/zephyr/soc/raspberrypi/rpi_pico/Kconfig"
osource "/home/adam/iomico/zephyr/soc/quicklogic/eos_s3/Kconfig"
osource "/home/adam/iomico/zephyr/soc/qemu/virt_riscv/Kconfig"
osource "/home/adam/iomico/zephyr/soc/qemu/or1k/Kconfig"
osource "/home/adam/iomico/zephyr/soc/qemu/malta/Kconfig"
osource "/home/adam/iomico/zephyr/soc/openisa/rv32m1/Kconfig"
osource "/home/adam/iomico/zephyr/soc/openhwgroup/cva6/Kconfig"
osource "/home/adam/iomico/zephyr/soc/oct/osd32mp15x/Kconfig"
osource "/home/adam/iomico/zephyr/soc/nxp/s32/Kconfig"
osource "/home/adam/iomico/zephyr/soc/nxp/rw/Kconfig"
osource "/home/adam/iomico/zephyr/soc/nxp/mcx/Kconfig"
osource "/home/adam/iomico/zephyr/soc/nxp/lpc/Kconfig"
osource "/home/adam/iomico/zephyr/soc/nxp/layerscape/Kconfig"
osource "/home/adam/iomico/zephyr/soc/nxp/kinetis/Kconfig"
osource "/home/adam/iomico/zephyr/soc/nxp/imxrt/Kconfig"
osource "/home/adam/iomico/zephyr/soc/nxp/imx/Kconfig"
osource "/home/adam/iomico/zephyr/soc/nuvoton/numicro/Kconfig"
osource "/home/adam/iomico/zephyr/soc/nuvoton/numaker/Kconfig"
osource "/home/adam/iomico/zephyr/soc/nuvoton/npcx/Kconfig"
osource "/home/adam/iomico/zephyr/soc/nuvoton/npcm/Kconfig"
osource "/home/adam/iomico/zephyr/soc/nordic/Kconfig"
osource "/home/adam/iomico/zephyr/soc/neorv32/Kconfig"
osource "/home/adam/iomico/zephyr/soc/native/inf_clock/Kconfig"
osource "/home/adam/iomico/zephyr/soc/microchip/sam/sama7/Kconfig"
osource "/home/adam/iomico/zephyr/soc/microchip/sam/sam_d5x_e5x/Kconfig"
osource "/home/adam/iomico/zephyr/soc/microchip/pic64/Kconfig"
osource "/home/adam/iomico/zephyr/soc/microchip/pic32c/pic32cz_ca/Kconfig"
osource "/home/adam/iomico/zephyr/soc/microchip/pic32c/pic32cx_sg/Kconfig"
osource "/home/adam/iomico/zephyr/soc/microchip/pic32c/pic32cm_pl/Kconfig"
osource "/home/adam/iomico/zephyr/soc/microchip/pic32c/pic32cm_jh/Kconfig"
osource "/home/adam/iomico/zephyr/soc/microchip/miv/Kconfig"
osource "/home/adam/iomico/zephyr/soc/microchip/mec/Kconfig"
osource "/home/adam/iomico/zephyr/soc/mediatek/mt8xxx/Kconfig"
osource "/home/adam/iomico/zephyr/soc/lowrisc/opentitan/Kconfig"
osource "/home/adam/iomico/zephyr/soc/litex/litex_vexriscv/Kconfig"
osource "/home/adam/iomico/zephyr/soc/ite/ec/Kconfig"
osource "/home/adam/iomico/zephyr/soc/intel/wildcat_lake/Kconfig"
osource "/home/adam/iomico/zephyr/soc/intel/raptor_lake/Kconfig"
osource "/home/adam/iomico/zephyr/soc/intel/panther_lake/Kconfig"
osource "/home/adam/iomico/zephyr/soc/intel/lakemont/Kconfig"
osource "/home/adam/iomico/zephyr/soc/intel/intel_socfpga_std/Kconfig"
osource "/home/adam/iomico/zephyr/soc/intel/intel_socfpga/Kconfig"
osource "/home/adam/iomico/zephyr/soc/intel/intel_niosv/Kconfig"
osource "/home/adam/iomico/zephyr/soc/intel/intel_ish/Kconfig"
osource "/home/adam/iomico/zephyr/soc/intel/intel_adsp/Kconfig"
osource "/home/adam/iomico/zephyr/soc/intel/elkhart_lake/Kconfig"
osource "/home/adam/iomico/zephyr/soc/intel/atom/Kconfig"
osource "/home/adam/iomico/zephyr/soc/intel/apollo_lake/Kconfig"
osource "/home/adam/iomico/zephyr/soc/intel/alder_lake/Kconfig"
osource "/home/adam/iomico/zephyr/soc/infineon/psoc4/Kconfig"
osource "/home/adam/iomico/zephyr/soc/infineon/edge/Kconfig"
osource "/home/adam/iomico/zephyr/soc/infineon/cat3/Kconfig"
osource "/home/adam/iomico/zephyr/soc/infineon/cat1c/Kconfig"
osource "/home/adam/iomico/zephyr/soc/infineon/cat1b/Kconfig"
osource "/home/adam/iomico/zephyr/soc/infineon/cat1a/Kconfig"
osource "/home/adam/iomico/zephyr/soc/gd/gd32/Kconfig"
osource "/home/adam/iomico/zephyr/soc/gaisler/leon3/Kconfig"
osource "/home/adam/iomico/zephyr/soc/gaisler/gr716a/Kconfig"
osource "/home/adam/iomico/zephyr/soc/focaltech/Kconfig"
osource "/home/adam/iomico/zephyr/soc/espressif/Kconfig"
osource "/home/adam/iomico/zephyr/soc/ene/kb1200/Kconfig"
osource "/home/adam/iomico/zephyr/soc/ene/kb106x/Kconfig"
osource "/home/adam/iomico/zephyr/soc/elan/em32f967/Kconfig"
osource "/home/adam/iomico/zephyr/soc/egis/Kconfig"
osource "/home/adam/iomico/zephyr/soc/efinix/sapphire/Kconfig"
osource "/home/adam/iomico/zephyr/soc/cdns/xtensa_sample_controller/Kconfig"
osource "/home/adam/iomico/zephyr/soc/cdns/swerv/Kconfig"
osource "/home/adam/iomico/zephyr/soc/cdns/sample_controller32/Kconfig"
osource "/home/adam/iomico/zephyr/soc/cdns/dc233c/Kconfig"
osource "/home/adam/iomico/zephyr/soc/brcm/bcmvk/Kconfig"
osource "/home/adam/iomico/zephyr/soc/brcm/bcm2712/Kconfig"
osource "/home/adam/iomico/zephyr/soc/brcm/bcm2711/Kconfig"
osource "/home/adam/iomico/zephyr/soc/blackberry/qnxhv_vm/Kconfig"
osource "/home/adam/iomico/zephyr/soc/bflb/Kconfig"
osource "/home/adam/iomico/zephyr/soc/atmel/sam0/Kconfig"
osource "/home/adam/iomico/zephyr/soc/atmel/sam/Kconfig"
osource "/home/adam/iomico/zephyr/soc/aspeed/Kconfig"
osource "/home/adam/iomico/zephyr/soc/arm/Kconfig"
osource "/home/adam/iomico/zephyr/soc/arm/beetle/Kconfig"
osource "/home/adam/iomico/zephyr/soc/antmicro/myra/Kconfig"
osource "/home/adam/iomico/zephyr/soc/andestech/Kconfig"
osource "/home/adam/iomico/zephyr/soc/amd/acp_6_0/Kconfig"
osource "/home/adam/iomico/zephyr/soc/ambiq/Kconfig"
osource "/home/adam/iomico/zephyr/soc/allwinner/sun8i_h3/Kconfig"
osource "/home/adam/iomico/zephyr/soc/alif/ensemble/Kconfig"
osource "/home/adam/iomico/zephyr/soc/aesc/Kconfig"
osource "/home/adam/iomico/zephyr/soc/adi/max32/Kconfig"
```
