## twister-out/native_sim_native/host_gnu/zephyr-intermediate/tests/temp_alarm/homework.unit.temp_alarm.ordered/Kconfig/Kconfig.modules
```kconfig
menu "cmsis_6 (/home/adam/iomico/modules/hal/cmsis_6)"
osource "$(ZEPHYR_CMSIS_6_KCONFIG)"
config ZEPHYR_CMSIS_6_MODULE
	bool
	default y
endmenu
menu "hal_nordic (/home/adam/iomico/modules/hal/nordic)"
osource "$(ZEPHYR_HAL_NORDIC_KCONFIG)"
config ZEPHYR_HAL_NORDIC_MODULE
	bool
	default y

config ZEPHYR_HAL_NORDIC_MODULE_BLOBS
	bool
endmenu
menu "hal_nxp (/home/adam/iomico/modules/hal/nxp)"
osource "$(ZEPHYR_HAL_NXP_KCONFIG)"
config ZEPHYR_HAL_NXP_MODULE
	bool
	default y

config ZEPHYR_HAL_NXP_MODULE_BLOBS
	bool
endmenu
config ZEPHYR_HAL_STM32_MODULE
	bool
	default y

config ZEPHYR_HAL_STM32_MODULE_BLOBS
	bool
```

## twister-out/native_sim_native/host_gnu/zephyr-intermediate/tests/temp_alarm/homework.unit.temp_alarm.ordered/Kconfig/boards/Kconfig.defconfig.tmp
```kconfig
# Load Zephyr board defconfig descriptions.
osource "/home/adam/iomico/zephyr/boards/native/native_sim/Kconfig.defconfig"
```

## twister-out/native_sim_native/host_gnu/zephyr-intermediate/tests/temp_alarm/homework.unit.temp_alarm.ordered/Kconfig/boards/Kconfig.native_sim.tmp
```kconfig
# Load board Kconfig descriptions.
osource "/home/adam/iomico/zephyr/boards/native/native_sim/Kconfig.native_sim"
```

## twister-out/native_sim_native/host_gnu/zephyr-intermediate/tests/temp_alarm/homework.unit.temp_alarm.ordered/Kconfig/soc/Kconfig.defconfig.tmp
```kconfig
# Load Zephyr SoC defconfig descriptions.
osource "/home/adam/iomico/zephyr/soc/xlnx/zynqmp/Kconfig.defconfig"
osource "/home/adam/iomico/zephyr/soc/xlnx/zynq7000/Kconfig.defconfig"
osource "/home/adam/iomico/zephyr/soc/xlnx/versalnet/Kconfig.defconfig"
osource "/home/adam/iomico/zephyr/soc/xlnx/versal2/Kconfig.defconfig"
osource "/home/adam/iomico/zephyr/soc/xlnx/versal/Kconfig.defconfig"
osource "/home/adam/iomico/zephyr/soc/xen/Kconfig.defconfig"
osource "/home/adam/iomico/zephyr/soc/wch/ch32v/Kconfig.defconfig"
osource "/home/adam/iomico/zephyr/soc/ti/simplelink/Kconfig.defconfig"
osource "/home/adam/iomico/zephyr/soc/ti/mspm0/Kconfig.defconfig"
osource "/home/adam/iomico/zephyr/soc/ti/lm3s6965/Kconfig.defconfig"
osource "/home/adam/iomico/zephyr/soc/ti/k3/Kconfig.defconfig"
osource "/home/adam/iomico/zephyr/soc/telink/tlsr/Kconfig.defconfig"
osource "/home/adam/iomico/zephyr/soc/syna/sr100/Kconfig.defconfig"
osource "/home/adam/iomico/zephyr/soc/starfive/jh71xx/Kconfig.defconfig"
osource "/home/adam/iomico/zephyr/soc/st/stm32/Kconfig.defconfig"
osource "/home/adam/iomico/zephyr/soc/snps/qemu_arc/Kconfig.defconfig"
osource "/home/adam/iomico/zephyr/soc/snps/nsim/arc_v/Kconfig.defconfig"
osource "/home/adam/iomico/zephyr/soc/snps/nsim/arc_classic/Kconfig.defconfig"
osource "/home/adam/iomico/zephyr/soc/snps/hsdk4xd/Kconfig.defconfig"
osource "/home/adam/iomico/zephyr/soc/snps/hsdk/Kconfig.defconfig"
osource "/home/adam/iomico/zephyr/soc/snps/emsk/Kconfig.defconfig"
osource "/home/adam/iomico/zephyr/soc/snps/emsdp/Kconfig.defconfig"
osource "/home/adam/iomico/zephyr/soc/snps/arc_iot/Kconfig.defconfig"
osource "/home/adam/iomico/zephyr/soc/silabs/Kconfig.defconfig"
osource "/home/adam/iomico/zephyr/soc/sifli/sf32/Kconfig.defconfig"
osource "/home/adam/iomico/zephyr/soc/sifive/sifive_freedom/Kconfig.defconfig"
osource "/home/adam/iomico/zephyr/soc/sensry/Kconfig.defconfig"
osource "/home/adam/iomico/zephyr/soc/rockchip/Kconfig.defconfig"
osource "/home/adam/iomico/zephyr/soc/renode/riscv_virtual/Kconfig.defconfig"
osource "/home/adam/iomico/zephyr/soc/renode/cortex_r8_virtual/Kconfig.defconfig"
osource "/home/adam/iomico/zephyr/soc/renesas/smartbond/Kconfig.defconfig"
osource "/home/adam/iomico/zephyr/soc/renesas/rz/Kconfig.defconfig"
osource "/home/adam/iomico/zephyr/soc/renesas/rx/Kconfig.defconfig"
osource "/home/adam/iomico/zephyr/soc/renesas/rcar/Kconfig.defconfig"
osource "/home/adam/iomico/zephyr/soc/renesas/ra/Kconfig.defconfig"
osource "/home/adam/iomico/zephyr/soc/realtek/fingerprint/Kconfig.defconfig"
osource "/home/adam/iomico/zephyr/soc/realtek/ec/Kconfig.defconfig"
osource "/home/adam/iomico/zephyr/soc/realtek/bee/Kconfig.defconfig"
osource "/home/adam/iomico/zephyr/soc/realtek/ameba/Kconfig.defconfig"
osource "/home/adam/iomico/zephyr/soc/raspberrypi/rpi_pico/Kconfig.defconfig"
osource "/home/adam/iomico/zephyr/soc/quicklogic/eos_s3/Kconfig.defconfig"
osource "/home/adam/iomico/zephyr/soc/qemu/virt_riscv/Kconfig.defconfig"
osource "/home/adam/iomico/zephyr/soc/qemu/or1k/Kconfig.defconfig"
osource "/home/adam/iomico/zephyr/soc/qemu/malta/Kconfig.defconfig"
osource "/home/adam/iomico/zephyr/soc/openisa/rv32m1/Kconfig.defconfig"
osource "/home/adam/iomico/zephyr/soc/openhwgroup/cva6/Kconfig.defconfig"
osource "/home/adam/iomico/zephyr/soc/oct/osd32mp15x/Kconfig.defconfig"
osource "/home/adam/iomico/zephyr/soc/nxp/s32/Kconfig.defconfig"
osource "/home/adam/iomico/zephyr/soc/nxp/rw/Kconfig.defconfig"
osource "/home/adam/iomico/zephyr/soc/nxp/mcx/Kconfig.defconfig"
osource "/home/adam/iomico/zephyr/soc/nxp/lpc/Kconfig.defconfig"
osource "/home/adam/iomico/zephyr/soc/nxp/layerscape/Kconfig.defconfig"
osource "/home/adam/iomico/zephyr/soc/nxp/kinetis/Kconfig.defconfig"
osource "/home/adam/iomico/zephyr/soc/nxp/imxrt/Kconfig.defconfig"
osource "/home/adam/iomico/zephyr/soc/nxp/imx/Kconfig.defconfig"
osource "/home/adam/iomico/zephyr/soc/nuvoton/numicro/Kconfig.defconfig"
osource "/home/adam/iomico/zephyr/soc/nuvoton/numaker/Kconfig.defconfig"
osource "/home/adam/iomico/zephyr/soc/nuvoton/npcx/Kconfig.defconfig"
osource "/home/adam/iomico/zephyr/soc/nuvoton/npcm/Kconfig.defconfig"
osource "/home/adam/iomico/zephyr/soc/nordic/Kconfig.defconfig"
osource "/home/adam/iomico/zephyr/soc/neorv32/Kconfig.defconfig"
osource "/home/adam/iomico/zephyr/soc/native/inf_clock/Kconfig.defconfig"
osource "/home/adam/iomico/zephyr/soc/microchip/sam/sama7/Kconfig.defconfig"
osource "/home/adam/iomico/zephyr/soc/microchip/sam/sam_d5x_e5x/Kconfig.defconfig"
osource "/home/adam/iomico/zephyr/soc/microchip/pic64/Kconfig.defconfig"
osource "/home/adam/iomico/zephyr/soc/microchip/pic32c/pic32cz_ca/Kconfig.defconfig"
osource "/home/adam/iomico/zephyr/soc/microchip/pic32c/pic32cx_sg/Kconfig.defconfig"
osource "/home/adam/iomico/zephyr/soc/microchip/pic32c/pic32cm_pl/Kconfig.defconfig"
osource "/home/adam/iomico/zephyr/soc/microchip/pic32c/pic32cm_jh/Kconfig.defconfig"
osource "/home/adam/iomico/zephyr/soc/microchip/miv/Kconfig.defconfig"
osource "/home/adam/iomico/zephyr/soc/microchip/mec/Kconfig.defconfig"
osource "/home/adam/iomico/zephyr/soc/mediatek/mt8xxx/Kconfig.defconfig"
osource "/home/adam/iomico/zephyr/soc/lowrisc/opentitan/Kconfig.defconfig"
osource "/home/adam/iomico/zephyr/soc/litex/litex_vexriscv/Kconfig.defconfig"
osource "/home/adam/iomico/zephyr/soc/ite/ec/Kconfig.defconfig"
osource "/home/adam/iomico/zephyr/soc/intel/wildcat_lake/Kconfig.defconfig"
osource "/home/adam/iomico/zephyr/soc/intel/raptor_lake/Kconfig.defconfig"
osource "/home/adam/iomico/zephyr/soc/intel/panther_lake/Kconfig.defconfig"
osource "/home/adam/iomico/zephyr/soc/intel/lakemont/Kconfig.defconfig"
osource "/home/adam/iomico/zephyr/soc/intel/intel_socfpga_std/Kconfig.defconfig"
osource "/home/adam/iomico/zephyr/soc/intel/intel_socfpga/Kconfig.defconfig"
osource "/home/adam/iomico/zephyr/soc/intel/intel_niosv/Kconfig.defconfig"
osource "/home/adam/iomico/zephyr/soc/intel/intel_ish/Kconfig.defconfig"
osource "/home/adam/iomico/zephyr/soc/intel/intel_adsp/Kconfig.defconfig"
osource "/home/adam/iomico/zephyr/soc/intel/elkhart_lake/Kconfig.defconfig"
osource "/home/adam/iomico/zephyr/soc/intel/atom/Kconfig.defconfig"
osource "/home/adam/iomico/zephyr/soc/intel/apollo_lake/Kconfig.defconfig"
osource "/home/adam/iomico/zephyr/soc/intel/alder_lake/Kconfig.defconfig"
osource "/home/adam/iomico/zephyr/soc/infineon/psoc4/Kconfig.defconfig"
osource "/home/adam/iomico/zephyr/soc/infineon/edge/Kconfig.defconfig"
osource "/home/adam/iomico/zephyr/soc/infineon/cat3/Kconfig.defconfig"
osource "/home/adam/iomico/zephyr/soc/infineon/cat1c/Kconfig.defconfig"
osource "/home/adam/iomico/zephyr/soc/infineon/cat1b/Kconfig.defconfig"
osource "/home/adam/iomico/zephyr/soc/infineon/cat1a/Kconfig.defconfig"
osource "/home/adam/iomico/zephyr/soc/gd/gd32/Kconfig.defconfig"
osource "/home/adam/iomico/zephyr/soc/gaisler/leon3/Kconfig.defconfig"
osource "/home/adam/iomico/zephyr/soc/gaisler/gr716a/Kconfig.defconfig"
osource "/home/adam/iomico/zephyr/soc/focaltech/Kconfig.defconfig"
osource "/home/adam/iomico/zephyr/soc/espressif/Kconfig.defconfig"
osource "/home/adam/iomico/zephyr/soc/ene/kb1200/Kconfig.defconfig"
osource "/home/adam/iomico/zephyr/soc/ene/kb106x/Kconfig.defconfig"
osource "/home/adam/iomico/zephyr/soc/elan/em32f967/Kconfig.defconfig"
osource "/home/adam/iomico/zephyr/soc/egis/Kconfig.defconfig"
osource "/home/adam/iomico/zephyr/soc/efinix/sapphire/Kconfig.defconfig"
osource "/home/adam/iomico/zephyr/soc/cdns/xtensa_sample_controller/Kconfig.defconfig"
osource "/home/adam/iomico/zephyr/soc/cdns/swerv/Kconfig.defconfig"
osource "/home/adam/iomico/zephyr/soc/cdns/sample_controller32/Kconfig.defconfig"
osource "/home/adam/iomico/zephyr/soc/cdns/dc233c/Kconfig.defconfig"
osource "/home/adam/iomico/zephyr/soc/brcm/bcmvk/Kconfig.defconfig"
osource "/home/adam/iomico/zephyr/soc/brcm/bcm2712/Kconfig.defconfig"
osource "/home/adam/iomico/zephyr/soc/brcm/bcm2711/Kconfig.defconfig"
osource "/home/adam/iomico/zephyr/soc/blackberry/qnxhv_vm/Kconfig.defconfig"
osource "/home/adam/iomico/zephyr/soc/bflb/Kconfig.defconfig"
osource "/home/adam/iomico/zephyr/soc/atmel/sam0/Kconfig.defconfig"
osource "/home/adam/iomico/zephyr/soc/atmel/sam/Kconfig.defconfig"
osource "/home/adam/iomico/zephyr/soc/aspeed/Kconfig.defconfig"
osource "/home/adam/iomico/zephyr/soc/arm/Kconfig.defconfig"
osource "/home/adam/iomico/zephyr/soc/arm/beetle/Kconfig.defconfig"
osource "/home/adam/iomico/zephyr/soc/antmicro/myra/Kconfig.defconfig"
osource "/home/adam/iomico/zephyr/soc/andestech/Kconfig.defconfig"
osource "/home/adam/iomico/zephyr/soc/amd/acp_6_0/Kconfig.defconfig"
osource "/home/adam/iomico/zephyr/soc/ambiq/Kconfig.defconfig"
osource "/home/adam/iomico/zephyr/soc/allwinner/sun8i_h3/Kconfig.defconfig"
osource "/home/adam/iomico/zephyr/soc/alif/ensemble/Kconfig.defconfig"
osource "/home/adam/iomico/zephyr/soc/aesc/Kconfig.defconfig"
osource "/home/adam/iomico/zephyr/soc/adi/max32/Kconfig.defconfig"
```

## twister-out/native_sim_native/host_gnu/zephyr-intermediate/tests/temp_alarm/homework.unit.temp_alarm/Kconfig/arch/Kconfig.tmp
```kconfig
# Load Zephyr Arch Kconfig descriptions.
osource "/home/adam/iomico/zephyr/arch/rx/Kconfig"
osource "/home/adam/iomico/zephyr/arch/x86/Kconfig"
osource "/home/adam/iomico/zephyr/arch/xtensa/Kconfig"
osource "/home/adam/iomico/zephyr/arch/sparc/Kconfig"
osource "/home/adam/iomico/zephyr/arch/riscv/Kconfig"
osource "/home/adam/iomico/zephyr/arch/posix/Kconfig"
osource "/home/adam/iomico/zephyr/arch/openrisc/Kconfig"
osource "/home/adam/iomico/zephyr/arch/mips/Kconfig"
osource "/home/adam/iomico/zephyr/arch/arm64/Kconfig"
osource "/home/adam/iomico/zephyr/arch/arm/Kconfig"
osource "/home/adam/iomico/zephyr/arch/arc/Kconfig"
```

## twister-out/native_sim_native/host_gnu/zephyr-intermediate/tests/temp_alarm/homework.unit.temp_alarm/Kconfig/boards/Kconfig.sysbuild
```kconfig
# Load Sysbuild board Kconfig descriptions.
osource "/home/adam/iomico/zephyr/boards/native/native_sim/Kconfig.sysbuild"
```
